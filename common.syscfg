// These arguments were used when this file was generated. They will be automatically applied on subsequent loads 
// via the GUI or CLI invocations. Run CLI with '--help' for additional information on how to override these arguments.
// @cliArgs --board "/ti/boards/CC3220SF_LAUNCHXL" --product "simplelink_cc32xx_sdk@3.30.01.02"
// @versions {"data":"2019103101","timestamp":"2019103101","tool":"1.3.1030","templates":"2019103101"}

var SimpleLinkWifi = scripting.addModule("/ti/drivers/net/wifi/SimpleLinkWifi");
var Crypto = scripting.addModule("/ti/drivers/Crypto");
var Crypto1 = Crypto.addInstance();
var Power = scripting.addModule("/ti/drivers/Power");
var Board = scripting.addModule("/ti/drivers/Board");
var DriverLib = scripting.addModule("/ti/devices/DriverLib");
var DMA = scripting.addModule("/ti/drivers/DMA");
var GPIO = scripting.addModule("/ti/drivers/GPIO");
var GPIO1 = GPIO.addInstance();
var GPIO2 = GPIO.addInstance();
var GPIO3 = GPIO.addInstance();
var Timer = scripting.addModule("/ti/drivers/Timer");
var Timer1 = Timer.addInstance();
var Timer2 = Timer.addInstance();
var Timer3 = Timer.addInstance();
var Watchdog = scripting.addModule("/ti/drivers/Watchdog");
var Watchdog1 = Watchdog.addInstance();
var GPIO4 = GPIO.addInstance();
var GPIO5 = GPIO.addInstance();
var GPIO6 = GPIO.addInstance();
var GPIO7 = GPIO.addInstance();
var GPIO8 = GPIO.addInstance();
var GPIO9 = GPIO.addInstance();
var SPI = scripting.addModule("/ti/drivers/SPI");
var SPI1 = SPI.addInstance();
var UART = scripting.addModule("/ti/drivers/UART", {}, false);
var UART1 = UART.addInstance();
var Display = scripting.addModule("/ti/display/Display", {}, false);
var Display1 = Display.addInstance();
var GPIO10 = GPIO.addInstance();
var GPIO11 = GPIO.addInstance();
var GPIO12 = GPIO.addInstance();
// Name - The C/C++ identifier used in applications as the index parameter passed to Crypto runtime APIs
Crypto1.$name = "CONFIG_Crypto_0";
// IO Retention Shutdown - IO groups to be retained during Shutdown
Power.ioRetentionShutdown = ["GRP_1"];
// Name
Power.parkPins.$name = "ti_drivers_power_PowerCC32XXPins0";
// Use Hardware - Select the hardware to use, or 'None' to use available header pins
GPIO1.$hardware = system.deviceData.board.components.LED_RED;
// Output Strength - Specifies the output strength
GPIO1.outputStrength = "High";
// Name - The C/C++ identifier used in applications as the index parameter passed to GPIO runtime APIs
GPIO1.$name = "CONFIG_GPIO_LED_0";
// Use Hardware - Select the hardware to use, or 'None' to use available header pins
GPIO2.$hardware = system.deviceData.board.components.LED_YELLOW;
// Output Strength - Specifies the output strength
GPIO2.outputStrength = "High";
// Name - The C/C++ identifier used in applications as the index parameter passed to GPIO runtime APIs
GPIO2.$name = "CONFIG_GPIO_LED_1";
// Use Hardware - Select the hardware to use, or 'None' to use available header pins
GPIO3.$hardware = system.deviceData.board.components.LED_GREEN;
// Output Strength - Specifies the output strength
GPIO3.outputStrength = "High";
// Name - The C/C++ identifier used in applications as the index parameter passed to GPIO runtime APIs
GPIO3.$name = "CONFIG_GPIO_LED_2";
// Name - The C/C++ identifier used in applications as the index parameter passed to Timer runtime APIs
Timer1.$name = "CONFIG_TIMER_0";
// Timer Type
Timer1.timerType = "32 Bits";
// Name
Timer1.timer.$name = "MyTimer1";
// Use Peripheral
Timer1.timer.$assign = "Timer0";
// Name - The C/C++ identifier used in applications as the index parameter passed to Timer runtime APIs
Timer2.$name = "CONFIG_TIMER_1";
// Name
Timer2.timer.$name = "MyTimer1";
// Use Peripheral
Timer2.timer.$assign = "Timer1";
// Name - The C/C++ identifier used in applications as the index parameter passed to Timer runtime APIs
Timer3.$name = "CONFIG_TIMER_2";
// Name
Timer3.timer.$name = "MyTimer1";
// Use Peripheral
Timer3.timer.$assign = "Timer1";
// Name - The C/C++ identifier used in applications as the index parameter passed to Watchdog runtime APIs
Watchdog1.$name = "CONFIG_WATCHDOG_0";
// Name
Watchdog1.watchdog.$name = "MyWATCHDOG1";
// Use Peripheral
Watchdog1.watchdog.$assign = "WATCHDOG0";
// Name - The C/C++ identifier used in applications as the index parameter passed to GPIO runtime APIs
GPIO4.$name = "CONFIG_GPIO_PIN_1";
// Mode - Select the GPIO mode
GPIO4.mode = "Output";
// Name - The C/C++ identifier used in applications as the index parameter passed to GPIO runtime APIs
GPIO5.$name = "CONFIG_GPIO_PIN_2";
// Mode - Select the GPIO mode
GPIO5.mode = "Output";
// Name - The C/C++ identifier used in applications as the index parameter passed to GPIO runtime APIs
GPIO6.$name = "CONFIG_GPIO_PIN_3";
// Mode - Select the GPIO mode
GPIO6.mode = "Output";
// Name - The C/C++ identifier used in applications as the index parameter passed to GPIO runtime APIs
GPIO7.$name = "CONFIG_GPIO_PIN_4";
// Mode - Select the GPIO mode
GPIO7.mode = "Output";
// Name - The C/C++ identifier used in applications as the index parameter passed to GPIO runtime APIs
GPIO8.$name = "CONFIG_GPIO_PIN_5";
// Mode - Select the GPIO mode
GPIO8.mode = "Output";
// Assign pin
GPIO8.gpioPin.$assign = "boosterpack.19"; // P18
// Name - The C/C++ identifier used in applications as the index parameter passed to GPIO runtime APIs
GPIO9.$name = "CONFIG_GPIO_PIN_7";
// Mode - Select the GPIO mode
GPIO9.mode = "Output";
// Assign pin
GPIO9.gpioPin.$assign = "boosterpack.30"; // P50
// Name - The C/C++ identifier used in applications as the index parameter passed to SPI runtime APIs
SPI1.$name = "CONFIG_SPI_0";
// Name
SPI1.spi.$name = "MySPI1";
// Name - The C/C++ identifier used in applications as the index parameter passed to UART runtime APIs
UART1.$name = "CONFIG_UART_0";
// Data Direction
UART1.dataDirection = "Send Only";
// Name
UART1.uart.$name = "MyUART1";
// Assign pin
UART1.uart.txPin.$assign = "boosterpack.4"; // P03
// Name - The C/C++ identifier used in applications as the index parameter passed to Display runtime APIs
Display1.$name = "CONFIG_Display_0";
// Use Hardware - Select the hardware to use, or 'None' to use available header pins
Display1.$hardware = system.deviceData.board.components.XDS110UART;
// Name - The C/C++ identifier used in applications as the index parameter passed to UART runtime APIs
Display1.uart.$name = "CONFIG_UART_1";
// Use DMA
Display1.uart.useDMA = true;
// Name
Display1.uart.uart.$name = "MyUART1";
// Name - The C/C++ identifier used in applications as the index parameter passed to GPIO runtime APIs
GPIO10.$name = "SPI_Encoder1";
// Assign pin
GPIO10.gpioPin.$assign = "boosterpack.13"; // P21
// Name - The C/C++ identifier used in applications as the index parameter passed to GPIO runtime APIs
GPIO11.$name = "SPI_Encoder2";
// Assign pin
GPIO11.gpioPin.$assign = "boosterpack.5"; // P61
// Name - The C/C++ identifier used in applications as the index parameter passed to GPIO runtime APIs
GPIO12.$name = "SPI_Encoder3";
// Assign pin
GPIO12.gpioPin.$assign = "boosterpack.18"; // P08
// Suggest solution
GPIO1.gpioPin.$suggestSolution = "64";
// Suggest solution
GPIO2.gpioPin.$suggestSolution = "1";
// Suggest solution
GPIO3.gpioPin.$suggestSolution = "2";
// Suggest solution
GPIO4.gpioPin.$suggestSolution = "45";
// Suggest solution
GPIO5.gpioPin.$suggestSolution = "53";
// Suggest solution
GPIO6.gpioPin.$suggestSolution = "58";
// Suggest solution
GPIO7.gpioPin.$suggestSolution = "59";
// Suggest solution
SPI1.spi.$suggestSolution = "SPI0";
// Suggest solution
SPI1.spi.sclkPin.$suggestSolution = "5";
// Suggest solution
SPI1.spi.misoPin.$suggestSolution = "6";
// Suggest solution
SPI1.spi.mosiPin.$suggestSolution = "7";
// Suggest solution
SPI1.spi.dmaRxChannel.$suggestSolution = "UDMA_CH30";
// Suggest solution
SPI1.spi.dmaTxChannel.$suggestSolution = "UDMA_CH31";
// Suggest solution
UART1.uart.$suggestSolution = "UART0";
// Suggest solution
Display1.uart.uart.$suggestSolution = "UART1";
// Suggest solution
Display1.uart.uart.txPin.$suggestSolution = "55";
// Suggest solution
Display1.uart.uart.rxPin.$suggestSolution = "57";
// Suggest solution
Display1.uart.uart.txDmaChannel.$suggestSolution = "UDMA_CH11";
// Suggest solution
Display1.uart.uart.rxDmaChannel.$suggestSolution = "UDMA_CH10";
